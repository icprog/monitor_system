#include "LZF5162.h"


/**********************************************************
 5MS定时程序 LIZHF 2013-12-25
 条件: 11..0592M晶振 CPU 1T
 占用资源:定时器0 启用定时器中断
**********************************************************/
void tm0_init(void)
{ 
  TMOD |= 0X01;//定时器  
   
  TH0=(65535-55296)/256;
  TL0=(65535-55296)%256; 
  ET0=1; 
 // EA=1;
 	
  TR0=1;
}








/*****************************
 1MS延时程序 LIZHF 2013-12-18
 条件: 11..0592M晶振 CPU 1T
 占用资源:定时器1
*****************************/
void delay_1ms(uint16_t x)
{ 
  TF1=0;
  TR1=1;
  while(x--)
  {   
   TH1=(65535-11050)/256;
   TL1=(65535-11050)%256;	   
   while(!TF1);	//等定时完成,TF1=1,WHILE为0跳出.
   TF1=0;
  }
  TF1=0;	
  TR1=0;
}


/*****************************
 1MS延时程序 LIZHF 2013-12-27
 条件: 11..0592M晶振 CPU 1T
 占用资源:定时器1
*****************************/
void delay(unsigned int x)
{

 unsigned int s;
 unsigned char j,k;
 for(s = 0;s<x;s++)
   for(j=0;j<15;j++)
     for(k=0;k<248;k++); 
}




/**********************************************************
 PWM1程序 LIZHF 2013-12-18
 条件: 11..0592M晶振 CPU 1T
 占用资源:PWM1 
**********************************************************/
void pwm0(uint8_t pwmp,uint8_t pwmd)
{

 //P2M0 = 0X0;
 //P2M1 = 0X0ff;  //改成全推挽输出
  //P2.7为PWM1
  PWM0P = pwmp;//PWM频率  = SYSCLK/2/0XFE
  PWM0D = pwmd;//占空比 = 0X7F/0XFE	 

  PWM0CON = 0X0|(1<<7)|(1<<0);
  //7位 1:开 0:关闭 6:极性,1:低 0:高 5-4:时钟分频,1:中断 0无1有,0:管脚,0:IO 1:PWM
 

}
/**********************************************************
 ADC初始化程序 LIZHF 2013-12-25
 条件: 11..0592M晶振 CPU 1T
 ADT为8F每次转换时间30.3uS
 **********************************************************/
void adcinit(void)
{
  P0M0 = 0X0FF;
  P0M1 = 0X0;  // 高阻态输入
  ADT = 0X0|(4<<5)|(15<<0);//TAD=1uS 采样15个周期,ADC一次30.3uS
  ADCH = 0X0FF;//P0口做ADC输入
  ADCON = 0X0|(1<<7)|(1<<4); 
  //7位开启ADC功能,4位选择外部VREF,  3~1位选择通道,0位开始转换	
}

/**********************************************************
 ADC转换程序 LIZHF 2013-12-25
 条件: 11.0592M晶振 CPU 1T
 输入:通道adn,等待30.3uS后,返回一个ADC结果,advalue
 **********************************************************/
uint16_t adcz(uint8_t adn)
{
  uint8_t	AD_H;
  uint8_t	AD_L;
  uint16_t ADValue=0;
  ADCON &= 0xf1;  //3~1位清0
  ADCON |= (adn<<1)|(1<<0); 
  //7位开启ADC功能,4位选择外部VREF,  3~1位选择通道,0位开始转换	
  while(ADCON&0X01);//0位为0则跳出.ADC转换完成
		AD_H=ADDH;
		ADValue=AD_H;
		ADValue=(ADValue<<2)&0xFFFC;
		AD_L=ADDL&0x03;
		ADValue=ADValue|AD_L;
		ADValue&=0x03ff;
	return	ADValue;

}

